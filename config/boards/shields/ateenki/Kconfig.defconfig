## config/boards/shields/ateenki/Kconfig.defconfig
```kconfig
config ZMK_BLE
    default y

config ZMK_USB
    default y

if SHIELD_ATEENKI_LEFT || SHIELD_ATEENKI_RIGHT
config ZMK_KEYBOARD_NAME
    default "ateenki"

endif
```

## config/boards/shields/ateenki/Kconfig.shield
```kconfig
config SHIELD_ATEENKI_LEFT
    def_bool $(shields_list_contains,ateenki_left)


config SHIELD_ATEENKI_RIGHT
    def_bool $(shields_list_contains,ateenki_right)
```
